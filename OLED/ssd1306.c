#include "ssd1306.h"
#include "MyIIC.h"   
#include "string.h"
#include "stdio.h"
#include "math.h"

/* ================================================================
 * 帧缓冲：128×64 / 8 = 1024 字节
 * ================================================================ */
static uint8_t s_buf[OLED_PAGES][OLED_W];

/* ================================================================
 * 6×8 ASCII 字模（32~127）
 * ================================================================ */
static const uint8_t s_font6x8[][6] = {
    {0x00,0x00,0x00,0x00,0x00,0x00}, /* ' ' */
    {0x00,0x00,0x5F,0x00,0x00,0x00}, /* '!' */
    {0x00,0x07,0x00,0x07,0x00,0x00}, /* '"' */
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    {0x08,0x04,0x08,0x10,0x08,0x00}, /* '~' */
};

/* ================================================================
 * OLED_DrawPixel  点亮/熄灭一个像素
 * ================================================================ */
void OLED_DrawPixel(uint8_t x, uint8_t y, uint8_t c)
{
    if(x >= OLED_W || y >= OLED_H) return;
    if(c)
        s_buf[y / 8][x] |=  (1 << (y % 8));
    else
        s_buf[y / 8][x] &= ~(1 << (y % 8));
}

/* ================================================================
 * OLED_DrawLine  Bresenham 直线
 * ================================================================ */
void OLED_DrawLine(uint8_t x0, uint8_t y0, uint8_t x1, uint8_t y1)
{
    int dx = abs((int)x1 - x0), sx = x0 < x1 ? 1 : -1;
    int dy = abs((int)y1 - y0), sy = y0 < y1 ? 1 : -1;
    int err = (dx > dy ? dx : -dy) / 2, e2;
    while(1)
    {
        OLED_DrawPixel(x0, y0, 1);
        if(x0 == x1 && y0 == y1) break;
        e2 = err;
        if(e2 > -dx) { err -= dy; x0 += sx; }
        if(e2 <  dy) { err += dx; y0 += sy; }
    }
}

/* ================================================================
 * OLED_DrawChar  6×8 字符
 * ================================================================ */
void OLED_DrawChar(uint8_t x, uint8_t y, char ch)
{
    if(ch < 32 || ch > 126) ch = '?';
    const uint8_t *font = s_font6x8[ch - 32];
    for(uint8_t i = 0; i < 6; i++)
    {
        uint8_t col = font[i];
        for(uint8_t j = 0; j < 8; j++)
            OLED_DrawPixel(x + i, y + j, (col >> j) & 1);
    }
}

/* ================================================================
 * OLED_DrawString  字符串
 * ================================================================ */
void OLED_DrawString(uint8_t x, uint8_t y, const char *str)
{
    while(*str)
    {
        if(x + 6 > OLED_W) break;
        OLED_DrawChar(x, y, *str++);
        x += 6;
    }
}


void OLED_Display(void)
{
    for(uint8_t page = 0; page < OLED_PAGES; page++)
    {
        //设置页地址 + 列起始0
        IIC_SendCommondToOled(0xB0 | page);
        IIC_SendCommondToOled(0x10 | (0 >>4));
        IIC_SendCommondToOled(0x00 | (0 & 0x0F));

        IIC_Start();
        IIC_SendByte(OLED_ADDR);
        IICWaitAck();
        IIC_SendByte(0x40); //数据模式
        IICWaitAck();

        for(uint8_t x=0;x<OLED_W;x++)
        {
            IIC_SendByte(s_buf[page][x]);
            IICWaitAck();
        }
        IIC_Stop();
    }
}